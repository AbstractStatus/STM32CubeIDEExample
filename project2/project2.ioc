# file: project2.ioc
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Mcu.Family=STM32L4
Mcu.Name=STM32L475V(C-E-G)Tx
Mcu.Package=LQFP100
NVIC.PriorityGroup=NVIC_PRIORITYGROUP_4
PA13\ (JTMS-SWDIO).Mode=JTAG_4_pins
PA13\ (JTMS-SWDIO).Signal=SYS_JTMS-SWDIO
PA14\ (JTCK-SWCLK).Mode=JTAG_4_pins
PA14\ (JTCK-SWCLK).Signal=SYS_JTCK-SWCLK
PA15\ (JTDI).Mode=JTAG_4_pins
PA15\ (JTDI).Signal=SYS_JTDI
PB3\ (JTDO-TRACESWO).Mode=JTAG_4_pins
PB3\ (JTDO-TRACESWO).Signal=SYS_JTDO-SWO
PC14-OSC32_IN\ (PC14).Mode=LSE-External-Oscillator
PC14-OSC32_IN\ (PC14).Signal=RCC_OSC32_IN
PC15-OSC32_OUT\ (PC15).Mode=LSE-External-Oscillator
PC15-OSC32_OUT\ (PC15).Signal=RCC_OSC32_OUT
PH0-OSC_IN\ (PH0).Mode=HSE-External-Oscillator
PH0-OSC_IN\ (PH0).Signal=RCC_OSC_IN
PH1-OSC_OUT\ (PH1).Mode=HSE-External-Oscillator
PH1-OSC_OUT\ (PH1).Signal=RCC_OSC_OUT
ProjectManager.HeapSize=0x200
ProjectManager.StackSize=0x400
ProjectManager.TargetToolchain=STM32CubeIDE
RCC.ADCFreq_Value=32000000
RCC.HSE_VALUE=8000000
RCC.HSI_VALUE=16000000
RCC.MSI_VALUE=4000000
RCC.PLLSourceVirtual=RCC_PLLSOURCE_HSE
RCC.USBFreq_Value=32000000
RCC.VCOOutputFreq_Value=64000000
board=custom

// file: Core/Src/main.c
/* USER CODE BEGIN Header */
/**
  ******************************************************************************
  * @file           : main.c
  * @brief          : Main program body
  ******************************************************************************
  * @attention
  *
  * Copyright (c) 2024 STMicroelectronics.
  * All rights reserved.
  *
  * This software is licensed under terms that can be found in the LICENSE file
  * in the root directory of this software component.
  * If no LICENSE file comes with this software, it is provided AS-IS.
  *
  ******************************************************************************
  */
/* USER CODE END Header */
#include "main.h"

/* USER CODE BEGIN Includes */
#include "sys.h"
#include "delay.h"
#include "led.h"
#include "beep.h"
#include "key.h"
#include "usart.h"
#include "stdio.h"
#include "retarget.h"
#include "exti.h"
/* USER CODE END Includes */

void SystemClock_Config(void);

/* USER CODE BEGIN 0 */
void extiExample() {
    printf("OK\r\n");           //打印OK提示程序运行
    delay_ms(1000);             //每隔1s打印一次
}

void usartExample() {
	static u16 times = 0;
    if(USART_RX_STA & 0x8000)
    {
        u8 len = USART_RX_STA & 0x3fff; //得到此次接收到的数据长度
        printf("\r\n your data:\r\n");
        HAL_UART_Transmit(&UART1_Handler, (uint8_t*)USART_RX_BUF, len, 1000);	//发送接收到的数据

        while(__HAL_UART_GET_FLAG(&UART1_Handler, UART_FLAG_TC) != SET);		//等待发送结束

        printf("\r\n\r\n");//插入换行
        USART_RX_STA = 0;
    }
    else
    {
        times++;
        if(times % 500 == 0)
        {
            printf("\r\nALIENTEK hehe\r\n");
        }

        if(times % 200 == 0)printf("press enter to continue\r\n");
        if(times % 30 == 0)LED_B_TogglePin; //闪烁LED,提示系统正在运行.

        delay_ms(10);
    }
}

void keyPressExample() {
	u8 key = KEY_Scan(0);          //按键扫描，不支持连续按

	switch(key)
	{
		case  WKUP_PRES:		//控制蜂鸣器状态翻转
			BEEP_TogglePin;
			break;

		case  KEY2_PRES:		//控制LED_B红灯状态翻转
			LED_B_TogglePin;
			break;

		case  KEY1_PRES:		//控制LED_G绿灯状态翻转
			LED_G_TogglePin;
			break;

		case  KEY0_PRES:		//控制LED_R蓝灯状态翻转
			LED_R_TogglePin;
			break;
		default:
			break;
	}

	delay_ms(10);
}

void LEDExample() {
	u8 color = 0;
	switch(color%7)
	{
		case 0:
			LED_R(0);
			LED_G(1);
			LED_B(1);
			break;
		case 1:
			LED_R(1);
			LED_G(0);
			LED_B(1);
			break;
		case 2:
			LED_R(1);
			LED_G(1);
			LED_B(0);
			break;
		case 3:
			LED_R(0);
			LED_G(0);
			LED_B(1);
			break;
		case 4:
			LED_R(0);
			LED_G(1);
			LED_B(0);
			break;
		case 5:
			LED_R(1);
			LED_G(0);
			LED_B(0);
			break;
		case 6:
			LED_R(0);
			LED_G(0);
			LED_B(0);
			//BEEP(1);
			break;
		default:
			break;
	}
	color++;
  delay_ms(10000);			//延时500ms就改变一次颜色
  //BEEP(0);
}
/* USER CODE END 0 */

int main(void)
{

  /* MCU Configuration--------------------------------------------------------*/

  /* Reset of all peripherals, Initializes the Flash interface and the Systick. */
  HAL_Init();

  /* Configure the system clock */
  SystemClock_Config();

  /* USER CODE BEGIN SysInit */
  delay_init(80); 		//初始化延时函数    80M系统时钟
  uart_init(115200);		//初始化串口，波特率为115200
  LED_Init();				//初始化LED
  BEEP_Init();
  KEY_Init();				//初始化KEY
  EXTI_Init();			//初始化外部中断
  RetargetInit(&UART1_Handler);
  /* USER CODE END SysInit */

  /* Initialize all configured peripherals */

  /* Infinite loop */
  while (1)
  {
	  extiExample();
  }
}

//void SystemClock_Config(void)
//{
//  RCC_OscInitTypeDef RCC_OscInitStruct = {0};
//  RCC_ClkInitTypeDef RCC_ClkInitStruct = {0};
//
//  /** Configure the main internal regulator output voltage
//  */
//  if (HAL_PWREx_ControlVoltageScaling(PWR_REGULATOR_VOLTAGE_SCALE1) != HAL_OK)
//  {
//    Error_Handler();
//  }
//
//  /** Initializes the RCC Oscillators according to the specified parameters
//  * in the RCC_OscInitTypeDef structure.
//  */
//  RCC_OscInitStruct.OscillatorType = RCC_OSCILLATORTYPE_MSI;
//  RCC_OscInitStruct.MSIState = RCC_MSI_ON;
//  RCC_OscInitStruct.MSICalibrationValue = 0;
//  RCC_OscInitStruct.MSIClockRange = RCC_MSIRANGE_6;
//  RCC_OscInitStruct.PLL.PLLState = RCC_PLL_NONE;
//  if (HAL_RCC_OscConfig(&RCC_OscInitStruct) != HAL_OK)
//  {
//    Error_Handler();
//  }
//
//  /** Initializes the CPU, AHB and APB buses clocks
//  */
//  RCC_ClkInitStruct.ClockType = RCC_CLOCKTYPE_HCLK|RCC_CLOCKTYPE_SYSCLK
//                              |RCC_CLOCKTYPE_PCLK1|RCC_CLOCKTYPE_PCLK2;
//  RCC_ClkInitStruct.SYSCLKSource = RCC_SYSCLKSOURCE_MSI;
//  RCC_ClkInitStruct.AHBCLKDivider = RCC_SYSCLK_DIV1;
//  RCC_ClkInitStruct.APB1CLKDivider = RCC_HCLK_DIV1;
//  RCC_ClkInitStruct.APB2CLKDivider = RCC_HCLK_DIV1;
//
//  if (HAL_RCC_ClockConfig(&RCC_ClkInitStruct, FLASH_LATENCY_0) != HAL_OK)
//  {
//    Error_Handler();
//  }
//}

void Error_Handler(void)
{
  __disable_irq();
  while (1)
  {
  }
}
